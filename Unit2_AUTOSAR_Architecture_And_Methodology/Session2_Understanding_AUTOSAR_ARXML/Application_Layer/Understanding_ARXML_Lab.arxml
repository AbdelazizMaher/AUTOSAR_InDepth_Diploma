AUTOSAR XML (schema 00044)
package /INTERFACES
  sender receiver interface SR_IF_LidarData
    data LidarSensor: type=uint32
