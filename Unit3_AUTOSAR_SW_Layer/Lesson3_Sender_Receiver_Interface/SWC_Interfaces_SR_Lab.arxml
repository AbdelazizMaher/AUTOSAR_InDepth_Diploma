AUTOSAR XML (schema 00044)
package /SR_INTERFACE_LAB
  sender receiver interface SR_LidarData
    data Lidar_ObjectDistance: type=uint16, init-value=7
    data Lidar_ObjectID: type=uint16, init-value=0
    data Lidar_ObjectAngle: type=uint32
  sensor actuator sw component type SWC_LidarSensor
    provide port PP_SR_LidarData: provided-interface=SR_LidarData
  application sw component type SWC_LidarAlgo
    require port RP_SR_LidarData: required-interface=SR_LidarData
