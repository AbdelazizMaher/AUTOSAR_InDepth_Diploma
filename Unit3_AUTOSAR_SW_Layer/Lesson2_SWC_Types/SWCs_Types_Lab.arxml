AUTOSAR XML (schema 00044)
package /SWCs_EABS_Packgae
  sensor actuator sw component type LidarSensor_SWC1
  sensor actuator sw component type SpeedSensor_SWC2
  ecu abstraction sw component type IOAbst_SWC3
  application sw component type EABS_SWC4
  parameter sw component type ParameterData_SWC5
  sensor actuator sw component type LED_Warning_SWC6
  complex device driver sw component type BrakeCDD_SWC7
  service sw component type DiagnosticManger_Service_SWC8
  nv block sw component type Flash_NVBLK_SWC9
