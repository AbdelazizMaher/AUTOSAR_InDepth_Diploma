AUTOSAR XML (schema 00044)
package /CS_INTERFACE_LAB
  client server interface CS_Interface
    operation CS_IF_SUM
      arg IN1: type=uint16, direction=IN
      arg IN2: type=uint16, direction=IN
      arg OUT: type=uint16, direction=OUT
  application sw component type SWC_Server
    provide port PP_CS_SUM: provided-interface=CS_IF_SUM
  application sw component type SWC_Client
    require port RP_CS_SUM: required-interface=CS_IF_SUM
