AUTOSAR XML (schema 00044)
standard types defined: uint8, sint8
package /MyDataTypes_Packages
  physical dimension LENGTH: length-exp=1
  unit Meters: factor-si-to-unit=1, physical-dimension=LENGTH
  app type MyMeter: category=VALUE, compu {identical; unit Meters}
  application array data type MyArray: category=ARRAY
    element ArrElements: type=MyMeter, array-size-semantics=FIXED-SIZE, max-number-of-elements=4
  application record data type MyStruct: category=STRUCTURE
    application record element VAL1: category=VALUE, type=MyMeter
    application record element VAL2: category=VALUE, type=MyMeter
  base type My_sint8: category=FIXED_LENGTH, max-base-type-size=8, base-type-encoding=NONE, mem-alignment=1, native-declaration=char
  base type My_uint8: category=FIXED_LENGTH, max-base-type-size=8, base-type-encoding=NONE, mem-alignment=1, native-declaration=unsigned char
  range DataConstr_uint8: phys 0..255, raw 0..255
  range DataConstr_sint8: phys -128..127, raw -128..127
  data type mapping set Mapping_MeterToUint8: data-type-map{application-data-type=MyMeter, implementation-data-type=uint8}
